## Config.in
```kconfig
source "$BR2_EXTERNAL_MCHP_PATH/package/g1-decoder/Config.in"
source "$BR2_EXTERNAL_MCHP_PATH/package/gst1-at91/Config.in"
source "$BR2_EXTERNAL_MCHP_PATH/package/libplanes/Config.in"
source "$BR2_EXTERNAL_MCHP_PATH/package/python-iocontrol/Config.in"
source "$BR2_EXTERNAL_MCHP_PATH/package/python-mpio/Config.in"
source "$BR2_EXTERNAL_MCHP_PATH/package/dt-overlay-at91/Config.in"
source "$BR2_EXTERNAL_MCHP_PATH/package/lora-gateway/Config.in"
```

## package/lora-gateway/Config.in
```kconfig
config BR2_PACKAGE_LORA_GATEWAY
	bool "lora-gateway"
	default y
	help
	  LORA Gateway software library. A simple lora interface library
	  for configured for a Microchip LORA radio connected to an SPI port.

config BR2_PACKAGE_LORA_GATEWAY_UTILS
	bool "lora-gateway-utils"
	depends on BR2_PACKAGE_LORA_GATEWAY
	help
		Utilities for testing the Lora gateway
```

## package/packet-forwarder/Config.in
```kconfig
config BR2_PACKAGE_PACKET_FORWARDER
	bool "packet-forwarder"
	default y
	depends on BR2_PACKAGE_LORA_GATEWAY
	help
	  LORA Packet forwarder software library. The packet forwarder forwards RF packets
	  received by the concentrator through an IP/UDP link to a server. Likewise
	  packets received from the server and forwarded to the concentrator and emitted
	  as RF packets.

config BR2_PACKAGE_PACKET_FORWARDER_UTILS
	bool "packet-forwarder-utils"
	default y
	depends on BR2_PACKAGE_PACKET_FORWARDER
	help
	  Utilities to help testing and configuring the LORA packet forwarder.
```
